# 1 "arch/arm/boot/dts/auto-generate/MOGOLIA_TL_CMCC_CERTIFICATION_noNFC_config.dts"
# 1 "<command-line>"
# 1 "arch/arm/boot/dts/auto-generate/MOGOLIA_TL_CMCC_CERTIFICATION_noNFC_config.dts"
# 10 "arch/arm/boot/dts/auto-generate/MOGOLIA_TL_CMCC_CERTIFICATION_noNFC_config.dts"
/dts-v1/;


/include/ "MOGOLIA_TL_V3_noNFC_config.dtsi"
/include/ "hisi_3630_pin_MOGOLIA_TL_CMCC_CERTIFICATION_noNFC.dtsi"
/include/ "hisi_3630_modem_MOGOLIA_TL_CMCC_CERTIFICATION_noNFC.dtsi"
/ {
 board_info: board_info {
  hisi,boardid = <1 2 7>;
  hisi,boardname = "Mogolia_TL_CMCC_Certification_noNFC";
  hisi,modem_id = <0x3FF10D00>;
  hw,public;
 };
};
